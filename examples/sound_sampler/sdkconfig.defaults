## examples/sound_sampler/sdkconfig.defaults
```kconfig
CONFIG_ESPTOOLPY_FLASHSIZE_4MB=y
CONFIG_ESPTOOLPY_FLASHFREQ_80M=y
CONFIG_ESPTOOLPY_FLASHMODE_QIO=y

CONFIG_SPIRAM_SPEED_80M=y

CONFIG_PARTITION_TABLE_CUSTOM=y
CONFIG_PARTITION_TABLE_CUSTOM_FILENAME="partitions.csv"

CONFIG_ESP_TIMER_TASK_STACK_SIZE=8192

CONFIG_FREERTOS_HZ=1000
CONFIG_FREERTOS_TIMER_TASK_AFFINITY_CPU0=y
CONFIG_FREERTOS_TIMER_TASK_PRIORITY=6
CONFIG_FREERTOS_TIMER_TASK_STACK_DEPTH=8192
CONFIG_FREERTOS_TIMER_SERVICE_TASK_CORE_AFFINITY=0x0

CONFIG_TIMER_TASK_PRIORITY=5
CONFIG_TIMER_TASK_STACK_SIZE=8192
CONFIG_TIMER_TASK_STACK_DEPTH=8192

CONFIG_MAIN_TASK_STACK_SIZE=20480

CONFIG_INT_WDT_TIMEOUT_MS=3000

CONFIG_ESP_TASK_WDT_CHECK_IDLE_TASK_CPU1=n

CONFIG_UART_ISR_IN_IRAM=y
```
